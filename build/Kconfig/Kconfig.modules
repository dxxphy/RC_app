## build/Kconfig/Kconfig.modules
```kconfig
menu "ARES framework (/home/librgod/zephyr_workspace/motor)"
osource "/home/librgod/zephyr_workspace/motor/Kconfig"
config ZEPHYR_ARES_FRAMEWORK_MODULE
	bool
	default y
endmenu
menu "cmsis (/home/librgod/zephyr_workspace/modules/hal/cmsis)"
osource "$(ZEPHYR_CMSIS_KCONFIG)"
config ZEPHYR_CMSIS_MODULE
	bool
	default y
endmenu
menu "cmsis-dsp (/home/librgod/zephyr_workspace/modules/lib/cmsis-dsp)"
osource "$(ZEPHYR_CMSIS_DSP_KCONFIG)"
config ZEPHYR_CMSIS_DSP_MODULE
	bool
	default y
endmenu
menu "cmsis_6 (/home/librgod/zephyr_workspace/modules/hal/cmsis_6)"
osource "$(ZEPHYR_CMSIS_6_KCONFIG)"
config ZEPHYR_CMSIS_6_MODULE
	bool
	default y
endmenu
menu "hal_st (/home/librgod/zephyr_workspace/modules/hal/st)"
osource "$(ZEPHYR_HAL_ST_KCONFIG)"
config ZEPHYR_HAL_ST_MODULE
	bool
	default y
endmenu
config ZEPHYR_HAL_STM32_MODULE
	bool
	default y

config ZEPHYR_HAL_STM32_MODULE_BLOBS
	bool
config ZEPHYR_MCUBOOT_MODULE
	bool
	default y
menu "segger (/home/librgod/zephyr_workspace/modules/debug/segger)"
osource "$(ZEPHYR_SEGGER_KCONFIG)"
config ZEPHYR_SEGGER_MODULE
	bool
	default y
endmenu
```

## build/Kconfig/Kconfig.shield.defconfig
```kconfig
osource "/home/librgod/zephyr_workspace/motor/boards/shields/*/Kconfig.defconfig"
```

## build/Kconfig/Kconfig.sysbuild.modules
```kconfig
config ZEPHYR_ARES_FRAMEWORK_MODULE
   bool
   default y
config ZEPHYR_CMSIS_MODULE
   bool
   default y
config ZEPHYR_CMSIS_DSP_MODULE
   bool
   default y
config ZEPHYR_CMSIS_6_MODULE
   bool
   default y
config ZEPHYR_HAL_ST_MODULE
   bool
   default y
config ZEPHYR_HAL_STM32_MODULE
   bool
   default y
config ZEPHYR_MCUBOOT_MODULE
   bool
   default y
config ZEPHYR_SEGGER_MODULE
   bool
   default y
```

## build/Kconfig/arch/Kconfig
```kconfig
# Load Zephyr Arch Kconfig descriptions.
osource "/home/librgod/zephyr_workspace/zephyr/arch/rx/Kconfig"
osource "/home/librgod/zephyr_workspace/zephyr/arch/x86/Kconfig"
osource "/home/librgod/zephyr_workspace/zephyr/arch/xtensa/Kconfig"
osource "/home/librgod/zephyr_workspace/zephyr/arch/sparc/Kconfig"
osource "/home/librgod/zephyr_workspace/zephyr/arch/riscv/Kconfig"
osource "/home/librgod/zephyr_workspace/zephyr/arch/posix/Kconfig"
osource "/home/librgod/zephyr_workspace/zephyr/arch/mips/Kconfig"
osource "/home/librgod/zephyr_workspace/zephyr/arch/arm64/Kconfig"
osource "/home/librgod/zephyr_workspace/zephyr/arch/arm/Kconfig"
osource "/home/librgod/zephyr_workspace/zephyr/arch/arc/Kconfig"
```

## build/Kconfig/boards/Kconfig
```kconfig
# Load Zephyr board Kconfig descriptions.
osource "/home/librgod/zephyr_workspace/motor/boards/dji/robomaster_board_c/Kconfig"
```

## build/Kconfig/boards/Kconfig.defconfig
```kconfig
# Load Zephyr board defconfig descriptions.
osource "/home/librgod/zephyr_workspace/motor/boards/dji/robomaster_board_c/Kconfig.defconfig"
```

## build/Kconfig/boards/Kconfig.robomaster_board_c
```kconfig
# Load board Kconfig descriptions.
osource "/home/librgod/zephyr_workspace/motor/boards/dji/robomaster_board_c/Kconfig.robomaster_board_c"
```

## build/Kconfig/boards/Kconfig.sysbuild
```kconfig
# Load Sysbuild board Kconfig descriptions.
osource "/home/librgod/zephyr_workspace/motor/boards/dji/robomaster_board_c/Kconfig.sysbuild"
```

## build/Kconfig/soc/Kconfig
```kconfig
# Load Zephyr SoC Kconfig descriptions.
osource "/home/librgod/zephyr_workspace/zephyr/soc/xlnx/zynqmp/Kconfig"
osource "/home/librgod/zephyr_workspace/zephyr/soc/xlnx/zynq7000/Kconfig"
osource "/home/librgod/zephyr_workspace/zephyr/soc/xlnx/versalnet/Kconfig"
osource "/home/librgod/zephyr_workspace/zephyr/soc/xlnx/versal2/Kconfig"
osource "/home/librgod/zephyr_workspace/zephyr/soc/xen/Kconfig"
osource "/home/librgod/zephyr_workspace/zephyr/soc/wch/ch32v/Kconfig"
osource "/home/librgod/zephyr_workspace/zephyr/soc/ti/simplelink/Kconfig"
osource "/home/librgod/zephyr_workspace/zephyr/soc/ti/mspm0/Kconfig"
osource "/home/librgod/zephyr_workspace/zephyr/soc/ti/lm3s6965/Kconfig"
osource "/home/librgod/zephyr_workspace/zephyr/soc/ti/k3/Kconfig"
osource "/home/librgod/zephyr_workspace/zephyr/soc/telink/tlsr/Kconfig"
osource "/home/librgod/zephyr_workspace/zephyr/soc/starfive/jh71xx/Kconfig"
osource "/home/librgod/zephyr_workspace/zephyr/soc/st/stm32/Kconfig"
osource "/home/librgod/zephyr_workspace/zephyr/soc/snps/qemu_arc/Kconfig"
osource "/home/librgod/zephyr_workspace/zephyr/soc/snps/nsim/arc_v/Kconfig"
osource "/home/librgod/zephyr_workspace/zephyr/soc/snps/nsim/arc_classic/Kconfig"
osource "/home/librgod/zephyr_workspace/zephyr/soc/snps/hsdk4xd/Kconfig"
osource "/home/librgod/zephyr_workspace/zephyr/soc/snps/hsdk/Kconfig"
osource "/home/librgod/zephyr_workspace/zephyr/soc/snps/emsk/Kconfig"
osource "/home/librgod/zephyr_workspace/zephyr/soc/snps/emsdp/Kconfig"
osource "/home/librgod/zephyr_workspace/zephyr/soc/snps/arc_iot/Kconfig"
osource "/home/librgod/zephyr_workspace/zephyr/soc/silabs/Kconfig"
osource "/home/librgod/zephyr_workspace/zephyr/soc/sifive/sifive_freedom/Kconfig"
osource "/home/librgod/zephyr_workspace/zephyr/soc/sensry/Kconfig"
osource "/home/librgod/zephyr_workspace/zephyr/soc/rockchip/Kconfig"
osource "/home/librgod/zephyr_workspace/zephyr/soc/renode/riscv_virtual/Kconfig"
osource "/home/librgod/zephyr_workspace/zephyr/soc/renode/cortex_r8_virtual/Kconfig"
osource "/home/librgod/zephyr_workspace/zephyr/soc/renesas/smartbond/Kconfig"
osource "/home/librgod/zephyr_workspace/zephyr/soc/renesas/rz/Kconfig"
osource "/home/librgod/zephyr_workspace/zephyr/soc/renesas/rx/Kconfig"
osource "/home/librgod/zephyr_workspace/zephyr/soc/renesas/rcar/Kconfig"
osource "/home/librgod/zephyr_workspace/zephyr/soc/renesas/ra/Kconfig"
osource "/home/librgod/zephyr_workspace/zephyr/soc/realtek/ec/Kconfig"
osource "/home/librgod/zephyr_workspace/zephyr/soc/raspberrypi/rpi_pico/Kconfig"
osource "/home/librgod/zephyr_workspace/zephyr/soc/quicklogic/eos_s3/Kconfig"
osource "/home/librgod/zephyr_workspace/zephyr/soc/qemu/virt_riscv/Kconfig"
osource "/home/librgod/zephyr_workspace/zephyr/soc/qemu/malta/Kconfig"
osource "/home/librgod/zephyr_workspace/zephyr/soc/openisa/rv32m1/Kconfig"
osource "/home/librgod/zephyr_workspace/zephyr/soc/openhwgroup/cva6/Kconfig"
osource "/home/librgod/zephyr_workspace/zephyr/soc/oct/osd32mp15x/Kconfig"
osource "/home/librgod/zephyr_workspace/zephyr/soc/nxp/s32/Kconfig"
osource "/home/librgod/zephyr_workspace/zephyr/soc/nxp/rw/Kconfig"
osource "/home/librgod/zephyr_workspace/zephyr/soc/nxp/mcx/Kconfig"
osource "/home/librgod/zephyr_workspace/zephyr/soc/nxp/lpc/Kconfig"
osource "/home/librgod/zephyr_workspace/zephyr/soc/nxp/layerscape/Kconfig"
osource "/home/librgod/zephyr_workspace/zephyr/soc/nxp/kinetis/Kconfig"
osource "/home/librgod/zephyr_workspace/zephyr/soc/nxp/imxrt/Kconfig"
osource "/home/librgod/zephyr_workspace/zephyr/soc/nxp/imx/Kconfig"
osource "/home/librgod/zephyr_workspace/zephyr/soc/nuvoton/numicro/Kconfig"
osource "/home/librgod/zephyr_workspace/zephyr/soc/nuvoton/numaker/Kconfig"
osource "/home/librgod/zephyr_workspace/zephyr/soc/nuvoton/npcx/Kconfig"
osource "/home/librgod/zephyr_workspace/zephyr/soc/nuvoton/npcm/Kconfig"
osource "/home/librgod/zephyr_workspace/zephyr/soc/nordic/Kconfig"
osource "/home/librgod/zephyr_workspace/zephyr/soc/neorv32/Kconfig"
osource "/home/librgod/zephyr_workspace/zephyr/soc/native/inf_clock/Kconfig"
osource "/home/librgod/zephyr_workspace/zephyr/soc/microchip/miv/Kconfig"
osource "/home/librgod/zephyr_workspace/zephyr/soc/microchip/mec/Kconfig"
osource "/home/librgod/zephyr_workspace/zephyr/soc/mediatek/mt8xxx/Kconfig"
osource "/home/librgod/zephyr_workspace/zephyr/soc/lowrisc/opentitan/Kconfig"
osource "/home/librgod/zephyr_workspace/zephyr/soc/litex/litex_vexriscv/Kconfig"
osource "/home/librgod/zephyr_workspace/zephyr/soc/ite/ec/Kconfig"
osource "/home/librgod/zephyr_workspace/zephyr/soc/intel/raptor_lake/Kconfig"
osource "/home/librgod/zephyr_workspace/zephyr/soc/intel/lakemont/Kconfig"
osource "/home/librgod/zephyr_workspace/zephyr/soc/intel/intel_socfpga_std/Kconfig"
osource "/home/librgod/zephyr_workspace/zephyr/soc/intel/intel_socfpga/Kconfig"
osource "/home/librgod/zephyr_workspace/zephyr/soc/intel/intel_niosv/Kconfig"
osource "/home/librgod/zephyr_workspace/zephyr/soc/intel/intel_ish/Kconfig"
osource "/home/librgod/zephyr_workspace/zephyr/soc/intel/intel_adsp/Kconfig"
osource "/home/librgod/zephyr_workspace/zephyr/soc/intel/elkhart_lake/Kconfig"
osource "/home/librgod/zephyr_workspace/zephyr/soc/intel/atom/Kconfig"
osource "/home/librgod/zephyr_workspace/zephyr/soc/intel/apollo_lake/Kconfig"
osource "/home/librgod/zephyr_workspace/zephyr/soc/intel/alder_lake/Kconfig"
osource "/home/librgod/zephyr_workspace/zephyr/soc/infineon/cat3/Kconfig"
osource "/home/librgod/zephyr_workspace/zephyr/soc/infineon/cat1b/Kconfig"
osource "/home/librgod/zephyr_workspace/zephyr/soc/infineon/cat1a/Kconfig"
osource "/home/librgod/zephyr_workspace/zephyr/soc/gd/gd32/Kconfig"
osource "/home/librgod/zephyr_workspace/zephyr/soc/gaisler/leon3/Kconfig"
osource "/home/librgod/zephyr_workspace/zephyr/soc/gaisler/gr716a/Kconfig"
osource "/home/librgod/zephyr_workspace/zephyr/soc/espressif/Kconfig"
osource "/home/librgod/zephyr_workspace/zephyr/soc/ene/kb1200/Kconfig"
osource "/home/librgod/zephyr_workspace/zephyr/soc/efinix/sapphire/Kconfig"
osource "/home/librgod/zephyr_workspace/zephyr/soc/cdns/xtensa_sample_controller/Kconfig"
osource "/home/librgod/zephyr_workspace/zephyr/soc/cdns/sample_controller32/Kconfig"
osource "/home/librgod/zephyr_workspace/zephyr/soc/cdns/dc233c/Kconfig"
osource "/home/librgod/zephyr_workspace/zephyr/soc/brcm/bcmvk/Kconfig"
osource "/home/librgod/zephyr_workspace/zephyr/soc/brcm/bcm2712/Kconfig"
osource "/home/librgod/zephyr_workspace/zephyr/soc/brcm/bcm2711/Kconfig"
osource "/home/librgod/zephyr_workspace/zephyr/soc/bflb/Kconfig"
osource "/home/librgod/zephyr_workspace/zephyr/soc/atmel/sam0/Kconfig"
osource "/home/librgod/zephyr_workspace/zephyr/soc/atmel/sam/Kconfig"
osource "/home/librgod/zephyr_workspace/zephyr/soc/aspeed/Kconfig"
osource "/home/librgod/zephyr_workspace/zephyr/soc/arm/Kconfig"
osource "/home/librgod/zephyr_workspace/zephyr/soc/arm/beetle/Kconfig"
osource "/home/librgod/zephyr_workspace/zephyr/soc/antmicro/myra/Kconfig"
osource "/home/librgod/zephyr_workspace/zephyr/soc/andestech/Kconfig"
osource "/home/librgod/zephyr_workspace/zephyr/soc/amd/acp_6_0/Kconfig"
osource "/home/librgod/zephyr_workspace/zephyr/soc/ambiq/Kconfig"
osource "/home/librgod/zephyr_workspace/zephyr/soc/aesc/Kconfig"
osource "/home/librgod/zephyr_workspace/zephyr/soc/adi/max32/Kconfig"
```
