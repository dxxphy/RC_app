## prj.conf
```kconfig
# 启用线程分析器
CONFIG_THREAD_ANALYZER=y
CONFIG_THREAD_ANALYZER_USE_LOG=y
CONFIG_THREAD_ANALYZER_USE_PRINTK=n
CONFIG_THREAD_NAME=y
# CONFIG_THREAD_ANALYZER_AUTO=y
# CONFIG_THREAD_ANALYZER_AUTO_INTERVAL=5
CONFIG_THREAD_ANALYZER_LOG_LEVEL_INF=y
CONFIG_THREAD_ANALYZER_AUTO_SEPARATE_CORES=n

# 启用 Shell 支持
CONFIG_SHELL=n
CONFIG_SHELL_BACKENDS=n
CONFIG_SHELL_BACKEND_SERIAL=n

# 启用 UART 控制台
CONFIG_UART_CONSOLE=y

# 禁用 SEGGER RTT
CONFIG_USE_SEGGER_RTT=n

# 启用事件支持
CONFIG_EVENTS=y

# 启用控制台支持
CONFIG_CONSOLE=y

# 启用日志系统
CONFIG_LOG=y
CONFIG_LOG_MODE_IMMEDIATE=y
CONFIG_LOG_PRINTK=y
CONFIG_LOG_BACKEND_UART=y
# CONFIG_LOG_MODE_IMMEDIATE=y

# 启用串行支持
CONFIG_SERIAL=y

# 禁用优化
CONFIG_NO_OPTIMIZATIONS=y

CONFIG_DMA=y
CONFIG_DMA_STM32=y  # STM32 DMA 驱动
CONFIG_UART_STM32=y # STM32 UART 驱动
# CONFIG_STM32_UART_DMA=y

# CONFIG_HAS_STM32CUBE=y
# CONFIG_USE_STM32_HAL_DMA=y
CONFIG_SPI=y
CONFIG_SPI_STM32=y

CONFIG_CMSIS_DSP=y
CONFIG_CMSIS_DSP_MATRIX=y
CONFIG_CMSIS_DSP_CONTROLLER=y
CONFIG_CMSIS_DSP_FASTMATH=y

CONFIG_MAIN_STACK_SIZE=2048
```

## src/main.c
```c
/*
 * Copyright (c) 2024 ttwards <12411711@mail.sustech.edu.cn>
 *
 * SPDX-License-Identifier: Apache-2.0
 */

#include "zephyr/arch/arch_interface.h"
#include <stddef.h>
#include <stdint.h>
#include <stdlib.h>
#include <string.h>
#include <zephyr/device.h>
#include <zephyr/logging/log.h>
#include <zephyr/devicetree.h>
#include <zephyr/drivers/sensor.h>
#include <zephyr/kernel.h>
#include <zephyr/sys/printk.h>
#include <ares/vofa/justfloat.h>
#include <ares/ekf/imu_task.h>
#include <ares/ekf/algorithm.h>
#include <ares/board/init.h>
#include <sys/_intsup.h>
#include <zephyr/debug/thread_analyzer.h>

#undef PI
#define PI 3.14159265f

LOG_MODULE_REGISTER(main, LOG_LEVEL_DBG);

#define UART_NODE DT_ALIAS(vofa)
const struct device *uart_dev = DEVICE_DT_GET(UART_NODE);

#define ACCEL_NODE DT_NODELABEL(bmi08x_accel)
const struct device *accel_dev = DEVICE_DT_GET(ACCEL_NODE);

#define GYRO_NODE DT_NODELABEL(bmi08x_gyro)
const struct device *gyro_dev = DEVICE_DT_GET(GYRO_NODE);

#define SAMPLE_COUNT 2000
#define READ_TIMES   3

/* CAN Feedback to console*/
K_THREAD_STACK_DEFINE(feedback_stack_area, 2048); // 定义线程栈
float g;
float sum_temp;
int read_times = 0;

float accel[3];
float speed[3];
float pos[3];

float current_temp;

void console_feedback(void *arg1, void *arg2, void *arg3)
{
	int n = 0;

	while (current_temp < 50) {
		k_msleep(750);
		current_temp = IMU_temp_read(accel_dev);
	}

	LOG_INF("Started reading IMU data");

	while (1) {
		k_msleep(1);
		n++;
		GetGroundAccel(QEKF_INS.q, QEKF_INS.Accel, QEKF_INS.g, accel);
		// accel[2] -= QEKF_INS.g;
		for (int i = 0; i < 3; i++) {
			speed[i] += accel[i] * 0.001f;
			pos[i] += speed[i] * 0.001f;
		}
		if (n % 100 == 0) {
			LOG_INF("VelZ: %.3f, Height: %.3fm", speed[2], pos[2]);
		}
	}
}
struct k_thread feedback_thread_data;

int main(void)
{
	board_init();
	struct JFData *jf = jf_send_init(uart_dev, 30);
	jf_channel_add(jf, &speed[0], PTR_FLOAT);
	jf_channel_add(jf, &speed[1], PTR_FLOAT);
	jf_channel_add(jf, &speed[2], PTR_FLOAT);

	jf_channel_add(jf, &QEKF_INS.q[0], PTR_FLOAT);
	jf_channel_add(jf, &QEKF_INS.q[1], PTR_FLOAT);
	jf_channel_add(jf, &QEKF_INS.q[2], PTR_FLOAT);
	jf_channel_add(jf, &QEKF_INS.q[3], PTR_FLOAT);

	jf_channel_add(jf, &accel[0], PTR_FLOAT);
	jf_channel_add(jf, &accel[1], PTR_FLOAT);
	jf_channel_add(jf, &accel[2], PTR_FLOAT);

	jf_channel_add(jf, &QEKF_INS.Gyro[0], PTR_FLOAT);
	jf_channel_add(jf, &QEKF_INS.Gyro[1], PTR_FLOAT);
	jf_channel_add(jf, &QEKF_INS.Gyro[2], PTR_FLOAT);

	jf_channel_add(jf, &QEKF_INS.g, PTR_FLOAT);

	IMU_Sensor_trig_init(accel_dev, gyro_dev);

	/* Start Feedback thread*/
	k_thread_create(&feedback_thread_data, feedback_stack_area,
			K_THREAD_STACK_SIZEOF(feedback_stack_area), console_feedback, NULL, NULL,
			NULL, 0, 0, K_NO_WAIT);

	k_sleep(K_MSEC(50));

	int t = 0;
	while (1) {
		k_msleep(25);
		t += 50;
	}
}
```
